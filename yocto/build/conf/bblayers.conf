## yocto/build/conf/bblayers.conf
```bitbake
# POKY_BBLAYERS_CONF_VERSION is increased each time build/conf/bblayers.conf
# changes incompatibly
POKY_BBLAYERS_CONF_VERSION = "2"

BBPATH = "${TOPDIR}"
BBFILES ?= ""

BBLAYERS ?= " \
  /workdir/yocto/poky/meta \
  /workdir/yocto/poky/meta-poky \
  /workdir/yocto/poky/meta-yocto-bsp \
  /workdir/yocto/meta-ti \
  "
```

## yocto/meta-bootlinlabs/conf/layer.conf
```bitbake
# We have a conf and classes directory, add to BBPATH
BBPATH .= ":${LAYERDIR}"

# We have recipes-* directories, add to BBFILES
BBFILES += "${LAYERDIR}/recipes-*/*/*.bb \
            ${LAYERDIR}/recipes-*/*/*.bbappend"

BBFILE_COLLECTIONS += "/workdir/yocto/meta-bootlinlabs"
BBFILE_PATTERN_/workdir/yocto/meta-bootlinlabs = "^${LAYERDIR}/"
BBFILE_PRIORITY_/workdir/yocto/meta-bootlinlabs = "7"
```

## yocto/meta-bootlinlabs/conf/machine/bootlinlabs.conf
```bitbake
#@TYPE: Machine
#@NAME: Bootlinlabs machine

require conf/machine/include/ti-soc.inc

#DEFAULTTUNE = "armv7athf-neon"
DEFAULTTUNE = "cortexa8thf-neon"
require conf/machine/include/tune-cortexa8.inc

PREFERRED_PROVIDER_virtual/kernel = "linux-ti-staging"
PREFERRED_PROVIDER_virtual/bootloader = "u-boot-ti-staging"
KERNEL_DEVICETREE = "am335x-boneblack-wireless.dtb"

KERNEL_IMAGETYPE = "zImage"

UBOOT_ARCH = "arm"
UBOOT_MACHINE = "am335x_boneblack_config"

UBOOT_ENTRYPOINT = "0x80008000"
UBOOT_LOADADDRESS = "0x80008000"

SERIAL_CONSOLE = "115200 ttyS0"

# List common SoC features, may need to add touchscreen for specific machines
MACHINE_FEATURES = "kernel26 apm usbgadget usbhost vfat ext2 alsa"
```
